## main/Kconfig.projbuild
```kconfig
menu "C5VRX-2 firmware mode"

choice C5VRX2_MODE
    prompt "Boot mode"
    default C5VRX2_MODE_LIVE

    config C5VRX2_MODE_LIVE
        bool "Live MODEM_DIAG IQ to recovered CVBS"

    config C5VRX2_MODE_RF_ORACLE
        bool "RF vendor pre-trigger oracle"

    config C5VRX2_MODE_RF_WRAP
        bool "RF physical-wrap phase diagnostic"

    config C5VRX2_MODE_RF_DMA
        bool "RF MAC-owned SRAM GDMA visibility diagnostic"

    config C5VRX2_MODE_RF_DMA_CPU_OWNED
        bool "RF GDMA visibility while HP CPU retains SRAM ownership"

    config C5VRX2_MODE_MODEM_DIAG
        bool "RF modem diagnostic bus activity probe"

    config C5VRX2_MODE_MODEM_CAPTURE
        bool "Capture XIAO-native candidate Q4/I4 modem bytes"

    config C5VRX2_MODE_MODEM_PARLIO
        bool "Capture proven Q4/I4 bus with PARLIO RX"

    config C5VRX2_MODE_MODEM_WBFM
        bool "Capture PARLIO-attached adjacent-FM output"

    config C5VRX2_MODE_TX_WBFM_TEST
        bool "Byte-exact PARLIO TX WBFM decorator test"

    config C5VRX2_MODE_AV_STATIC
        bool "AV static DAC code"

    config C5VRX2_MODE_AV_PAL_MONO
        bool "AV synthetic monochrome PAL"

    config C5VRX2_MODE_AV_PAL_COLOR
        bool "AV synthetic PAL colour bars"
endchoice

config C5VRX2_AV_STATIC_CODE
    int "Static DAC code"
    depends on C5VRX2_MODE_AV_STATIC
    range 0 63
    default 18

config C5VRX2_LIVE_SNAPSHOT_ONCE
    bool "Persist one live raw Q4/I4 ring for offline diagnosis"
    depends on C5VRX2_MODE_LIVE
    default n
    help
        Start the live input transport, snapshot the 16384-byte raw Q4/I4
        ring, then explicitly stop RF/PARLIO and persist it in diagcap. This
        is a bounded hardware diagnostic only; normal live firmware remains
        continuous and never writes its realtime ring to flash.

config C5VRX2_LIVE_SNAPSHOT_RAW_Q4
    bool "Bypass TX WBFM/DAC while taking the raw snapshot"
    depends on C5VRX2_LIVE_SNAPSHOT_ONCE
    default n
    help
        Bypass the BitScrambler and DAC for the bounded snapshot and persist
        the exact 40-MS/s MODEM_DIAG Q4/I4 bytes. This isolates input sample
        integrity from adjacent-FM, rate conversion, gain and clamping.

config C5VRX2_WBFM_SELFTEST_ONCE
    bool "Run bounded Q4 WBFM BitScrambler loopback self-test"
    depends on C5VRX2_MODE_LIVE
    default n
    help
        Feed deterministic Q4/I4 bytes to the exact production BitScrambler
        program through its hardware loopback, compare against the C reference,
        and persist input/actual/expected data in diagcap. RF is not started.

config C5VRX2_WBFM_TRAJECTORY
    bool "Test middle-sample trajectory LUT (issue 9 candidate)"
    depends on C5VRX2_MODE_LIVE || C5VRX2_MODE_TX_WBFM_TEST
    default n
    help
        Two-bundle 40 MS/s IQ to 20 MS/s DAC candidate with an embedded
        phase4/middle-signs/phase4 trajectory table. Overrides phase5 when
        enabled. Fixed gain=2, pedestal=20, current-minus-previous polarity.
        The shipped uniform geometry prior is NOT capture-trained. Keep
        phase5 as the default until independent capture and hardware A/B
        validation pass. Uses bounded TX oracle variant 8 in test mode.

config C5VRX2_TX_ORACLE_HIGH_NIBBLE
    bool "Capture trajectory oracle output bits 4..7"
    depends on C5VRX2_MODE_TX_WBFM_TEST && C5VRX2_WBFM_TRAJECTORY
    default n
    help
        Complement the default low-nibble oracle with the high output bank.
        VALID consumes an RX lane, so both banks need separate deterministic
        runs. TX pin order, rate and embedded program remain identical.
        Diagnostic record version 10 is low bank, 11 is high bank.

config C5VRX2_WBFM_PHASE5_QUALITY
    bool "Use uniform five-bit polar WBFM core"
    depends on C5VRX2_MODE_LIVE || C5VRX2_MODE_TX_WBFM_TEST
    default y
    help
        Use an embedded dual-purpose LUT that maps the complete Q4/I4 byte to
        uniform five-bit phase before FM differencing. A one-time prime is
        followed by a two-bundle steady-state pipeline. Disable this to use
        the physically proven Q3/I2 Cartesian fallback.

config C5VRX2_PARLIO_RX_NEG_EDGE
    bool "Sample MODEM_DIAG on the opposite PARLIO RX clock edge"
    depends on C5VRX2_MODE_LIVE || C5VRX2_MODE_MODEM_PARLIO || C5VRX2_MODE_MODEM_WBFM
    default n
    help
        Hardware A/B for GPIO-matrix setup/hold margin. The ESP-IDF edge
        labels have changed semantics on some C5 revisions, so POS/NEG are
        treated only as two physical candidates. This does not change the
        40 MS/s receive rate or the 20 MS/s DAC rate.

choice C5VRX2_PARLIO_RX_CLOCK
    prompt "PARLIO RX acquisition clock"
    depends on C5VRX2_MODE_LIVE || C5VRX2_MODE_MODEM_PARLIO || C5VRX2_MODE_MODEM_WBFM
    default C5VRX2_PARLIO_RX_CLOCK_INTERNAL

config C5VRX2_PARLIO_RX_CLOCK_INTERNAL
    bool "Internal PLL_F240M-derived 40 MHz (A/B baseline)"

config C5VRX2_PARLIO_RX_CLOCK_PLL_F40
    bool "External PLL_F40M on GPIO2 (phase-related candidate)"
    help
        Route the documented PLL_F40M clock-output source to GPIO2 and feed
        it back into PARLIO CLK_IN. This is not called source-synchronous
        until the raw-IQ hardware A/B passes.

config C5VRX2_PARLIO_RX_CLOCK_MODEM_DEBUG40
    bool "External MODEM DEBUG_CLK40 on GPIO2 (experimental source-sync)"
    help
        Enable MODEM_SYSCON FPGA_DEBUG_CLK40/CLKSWITCH and route a selected
        MODEM_DIAG lane to GPIO2 -> PARLIO CLK_IN. ESP32-C5 headers prove the
        control bit exists but do not document which DIAG lane carries it.
        Use only the issue-12 hardware matrix until lane and edge are proven.
endchoice

config C5VRX2_MODEM_DEBUG40_DIAG_SIGNAL
    int "MODEM_DIAG lane carrying DEBUG_CLK40"
    depends on C5VRX2_PARLIO_RX_CLOCK_MODEM_DEBUG40
    range 0 31
    default 21
    help
        DIAG21 is a test hypothesis, not a production fact. Record the lane
        and verify a continuous 40 MHz waveform with a scope or logic analyzer.

endmenu
```
